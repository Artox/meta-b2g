## conf/layer.conf
```bitbake
# We have a conf and classes directory, append to BBPATH
BBPATH .= ":${LAYERDIR}"

# We have a recipes directory, add to BBFILES
BBFILES += "${LAYERDIR}/recipes-b2g/*/*.bb ${LAYERDIR}/recipes-b2g/*/*.bbappend"

BBFILE_COLLECTIONS += "b2g-layer"
BBFILE_PATTERN_b2g-layer := "^${LAYERDIR}/"
BBFILE_PRIORITY_b2g-layer = "7"
```
